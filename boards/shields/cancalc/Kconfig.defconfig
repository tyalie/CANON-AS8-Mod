## boards/shields/cancalc/Kconfig.defconfig
```kconfig
# vim:fileencoding=utf-8:foldmethod=marker
# Copyright (c) 2023 Sophie Tyalie
# SPDX-License-Identifier: Apache-2.0

if SHIELD_CANON_AS8_CALC_1

menu "Canon Calc shield settings"

# input subsystem / key-scanning {{{
config INPUT
  default y

config INPUT_GPIO_KSCAN
  default y

choice INPUT_MODE
  default INPUT_MODE_THREAD
endchoice
# }}}
# display {{{
# communication
config I2C
  default y

config DISPLAY
  default y

config SSD1306
  default y

config SSD1306_DEFAULT_CONTRAST
  default 60  # set default brightness here

## UI frameworks {{{

choice CALC_UI_FRAMEWORK
  prompt "UI framework to use"
  default CALC_UI_CHARACTER_FRAMEBUFFER

config CALC_UI_CHARACTER_FRAMEBUFFER
  bool "character framebuffer (cfb) for drawing to ui"

config CALC_UI_LVGL
  bool "Fully featured UI framework (lvgl)"

config CALC_UI_NONE
  bool "No UI framework"

endchoice

### character framebuffer {{{
config CHARACTER_FRAMEBUFFER
  default y if CALC_UI_CHARACTER_FRAMEBUFFER
  default n
### }}}
### lvgl {{{
config LVGL
  default y if CALC_UI_LVGL
  default n

if LVGL

config LV_CONF_MINIMAL
  default y
config LV_MEM_CUSTOM
  default y
config LV_Z_MEM_POOL_SIZE
  default 16384

# oled monochrome display configuration
choice LV_COLOR_DEPTH
  default LV_COLOR_DEPTH_1
endchoice
config LV_Z_BITS_PER_PIXEL
  default 1
config LV_DPI_DEF
  default 127
config LV_Z_VDB_SIZE
  default 100

config LV_USE_LOG
  default y

# theming
config LV_USE_THEME_DEFAULT
  default y
config LV_THEME_DEFAULT_GROW
  default n
config LV_THEME_DEFAULT_DARK
  default y
config LV_USE_THEME_MONO
  default y

# components
config LV_USE_LABEL
  default y
config LV_FONT_MONTSERRAT_8
  default y

endif
# }}}
# }}}
# }}}
# flash {{{
# in order to be able to access 8mb flash programmatically
config FLASH
  default y
# }}}

# other stuff {{{
# otherwise we had to deal with very nasty stack overflows
config LOG_PROCESS_THREAD_STACK_SIZE
  default 2048
# }}}

endmenu

endif # CANON_AS8_CALC_1
```

## boards/shields/cancalc/Kconfig.shield
```kconfig
# Copyright (c) 2023 Sophie Tyalie
# SPDX-License-Identifier: Apache-2.0

config SHIELD_CANON_AS8_CALC_1
  def_bool $(shields_list_contains,canon_as8_calc_1)
  depends on BOARD_XIAO_ESP32S3
```

## drivers/input/Kconfig
```kconfig
if INPUT

menu "Input drivers"

rsource "Kconfig.kscan"

endmenu # Input Drivers

endif # INPUT
```

## drivers/input/Kconfig.kscan
```kconfig
# Copyright (c) 2023 Sophie Tyalie
# SPDX-License-Identifier: Apache-2.0

config INPUT_GPIO_KSCAN
	bool "GPIO key matrix scanning input driver"
	default n
	depends on DT_HAS_KSCAN_ENABLED
	depends on GPIO
	help
	  Enable support key matrix input driver
```

## dts/bindings/input/gpio-kscan.yaml
```yaml
# Copyright (c) 2023 Sophie Tyalie
# SPDX-License-Identifier: Apache-2.0

description: |
  Zephyr Input GPIO kscan parent node

  This defines a group of gpio pairs (input / output) which produce an input
  event from a connected keyboard matrix. Each pair and their corresponding key
  code are specified in a child-node.

  for example

  #include <zephyr/dt-bindings/input/input-event-codes.h>

  / {
      keyboard {
          compatible = "gpio-kscan";

          key_0 {
              input-gpios = <&gpio0 13 (GPIO_PULL_UP | GPIO_ACTIVE_LOW)>;
              output-gpios = <&gpio0 13 GPIO_ACTIVE_LOW>;
              zephyr,code = <INPUT_KEY_0>;
          };
      };
  };


compatible: "gpio-kscan"

include: base.yaml

#properties:
#  # TODO

child-binding:
  description: GPIO kscan child node
  properties:
    input-gpios:
      type: phandle-array
      required: true
      description: The input pin for this key
    output-gpios:
      type: phandle-array
      required: true
      description: The output pin for this key
    zephyr,code:
      type: int
      required: true
      description: keycode to emit
```

## manifest/west.yml
```yaml
# Copyright (c) 2023 Sophie Tyalie
# SPDX-License-Identifier: MIT

manifest:
  self:
    path: manifest

  remotes:
    - name: zephyrproject-rtos
      url-base: https://github.com/zephyrproject-rtos
    - name: km
      url-base: https://github.com/kickmaker
    - name: tyalie
      url-base: https://github.com/tyalie

  projects:
    - name: zephyr
      remote: zephyrproject-rtos
      revision: main
      import:
        # By using name-allowlist we can clone only the modules that are
        # strictly needed by the application.
        name-allowlist:
          - hal_espressif
          - mcuboot
          - mbedtls
          - lvgl
    - name: heatshrink
      remote: km
      revision: zephyr
      path: modules/lib/heatshrink
    - name: libast
      remote: tyalie
      revision: master
      path: modules/lib/libast
```
